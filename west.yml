## west.yml
```yaml
# Copyright (c) 2022 STMicroelectronics
# SPDX-License-Identifier: Apache-2.0

manifest:
  remotes:
    - name: openamp
      url-base: https://github.com/OpenAMP
    - name: zephyr
      url-base: https://github.com/zephyrproject-rtos
    - name: arnopo
      url-base: https://github.com/arnopo
  defaults:
    remote: openamp

  self:
    path: openamp-system-reference

  projects:
    - name: zephyr
      remote: zephyr
      revision: v3.5.0-rc3
      import: true

    - name: libmetal
      path: libmetal
      revision: main

    - name: open-amp
      path: open-amp
      revision: main

    - name: openamp-zephyr-module
      remote: arnopo
      repo-path: openamp-system-reference
      revision: openamp-zephyr-module
```
